## main/Kconfig.projbuild
```kconfig
menu "FlipDotCircleClock Configuration"

    config WIFI_SSID
        string "WiFi SSID"
        default ""
        help
            WiFi network name to connect to. Set via idf.py menuconfig.

    config WIFI_PASSWORD
        string "WiFi Password"
        default ""
        help
            WiFi password. Set via idf.py menuconfig.

endmenu
```
